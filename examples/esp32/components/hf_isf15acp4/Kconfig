## examples/esp32/components/hf_isf15acp4/Kconfig
```kconfig
menu "HF ISF15ACP4 SmartDisplay"

config ISF15ACP4_SPI_HOST
    int "SPI host (1=SPI2, 2=SPI3)"
    range 1 2
    default 1

config ISF15ACP4_PIN_MOSI
    int "MOSI GPIO"
    default 11

config ISF15ACP4_PIN_SCLK
    int "SCLK GPIO"
    default 12

config ISF15ACP4_PIN_CS
    int "Chip select GPIO (software SS)"
    default 10

config ISF15ACP4_PIN_DC
    int "Data/Command GPIO"
    default 13

config ISF15ACP4_PIN_RES
    int "Reset GPIO"
    default 14

config ISF15ACP4_PIN_VCC_EN
    int "VCC enable GPIO"
    default 9

config ISF15ACP4_PIN_SWITCH
    int "Pushbutton GPIO"
    default 8

endmenu
```
